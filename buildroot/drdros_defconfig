## buildroot/drdros_defconfig
```kconfig
# DrDrOS Buildroot configuration (drdros_defconfig)
#
# Kconfig syntax:  BR2_OPTION=y   (enable)   |   BR2_OPTION="value"   (set string)
#                  # BR2_OPTION is not set    (explicitly disable a default-on option)
# Anything not listed defaults to "off".
#
# To apply this defconfig:
#     make -C buildroot/upstream BR2_DEFCONFIG=$(pwd)/buildroot/drdros_defconfig defconfig
# Then to build everything (kernel + rootfs):
#     make -C buildroot/upstream
# Output lands in buildroot/upstream/output/images/.
#
# To minimise this file after future Kconfig edits:
#     make -C buildroot/upstream \
#         BR2_DEFCONFIG=$(pwd)/buildroot/drdros_defconfig savedefconfig
# (Note: savedefconfig strips comments. This file is hand-maintained for clarity.)

# ─── Target architecture ────────────────────────────────────────────────
# DrDrOS targets x86_64 PCs from the last 20 years.
BR2_x86_64=y

# ─── Toolchain ──────────────────────────────────────────────────────────
# Buildroot will compile its own cross-compiler from source on the first
# `make` run (~10–20 minutes once, cached afterwards). We pick the musl C
# library: ~600 KB instead of glibc's ~30 MB, and friendly to static linking.
BR2_TOOLCHAIN_BUILDROOT_MUSL=y

# ─── Linux kernel ───────────────────────────────────────────────────────
# Build the kernel from upstream sources, starting from the standard
# `arch/x86/configs/x86_64_defconfig`, then layer our config fragment on
# top. The stock x86_64 defconfig ships NO framebuffer at all, so
# linux-fb.config enables a DRM display driver for QEMU's `-vga std`
# plus the fbdev-emulation layer that creates /dev/fb0 — without it the
# whole framebuffer-only userland has nothing to draw on.
BR2_LINUX_KERNEL=y
BR2_LINUX_KERNEL_USE_DEFCONFIG=y
BR2_LINUX_KERNEL_DEFCONFIG="x86_64"
BR2_LINUX_KERNEL_CONFIG_FRAGMENT_FILES="$(BR2_EXTERNAL_DRDROS_PATH)/linux-fb.config"

# ─── Root filesystem ────────────────────────────────────────────────────
# Ship the rootfs as a gzipped cpio archive (initramfs). The Linux kernel
# unpacks this straight into RAM at boot — no disk needed, ever. Skip the
# default-on tarball rootfs since we never use it.
BR2_TARGET_ROOTFS_CPIO=y
BR2_TARGET_ROOTFS_CPIO_GZIP=y
# BR2_TARGET_ROOTFS_TAR is not set

# ─── System identity ────────────────────────────────────────────────────
BR2_TARGET_GENERIC_HOSTNAME="drdros"
BR2_TARGET_GENERIC_ISSUE="Welcome to DrDrOS"

# ─── Init system ────────────────────────────────────────────────────────
# Disable Buildroot's default BusyBox init; the kernel will run /init
# from the initramfs, and our BR2_EXTERNAL package installs drdr-init
# there as the very first userland process (PID 1).
# BR2_INIT_BUSYBOX is not set
BR2_INIT_NONE=y

# ─── DrDrOS userland packages (from BR2_EXTERNAL) ───────────────────────
# `make ... BR2_EXTERNAL=$(pwd)/buildroot/external defconfig` makes
# these options available; otherwise they're silently ignored.
BR2_PACKAGE_DRDR_INIT=y
BR2_PACKAGE_DRDR_APPS=y

# BusyBox itself stays enabled so we still have /bin/sh + standard
# coreutils as a fallback. drdr-init tries /bin/drdr-shell first and
# falls back to /bin/sh if our shell hasn't been installed.
```

## buildroot/external/Config.in
```kconfig
# Top-level Kconfig for the DRDROS BR2_EXTERNAL tree.
# Buildroot sources this file from its main Config.in when
# BR2_EXTERNAL=$(pwd)/buildroot/external is passed at configure time.

menu "DrDrOS packages"

source "$BR2_EXTERNAL_DRDROS_PATH/package/drdr-init/Config.in"

endmenu
```

## buildroot/external/package/drdr-apps/Config.in
```kconfig
config BR2_PACKAGE_DRDR_APPS
	bool "drdr-apps (DrDrShell + DrDrFiles + DrDrEdit)"
	help
	  The DrDrOS userland: a custom shell, file manager, and editor,
	  cross-compiled from the workspace at $(BR2_EXTERNAL_DRDROS_PATH)/../.. .
	  Built statically-linked against musl via the host's rustup toolchain.
	  Installs the binaries under /bin/ in the rootfs so they're on PATH.

	  https://github.com/gravijet/DrDrOS
```

## buildroot/external/package/drdr-init/Config.in
```kconfig
config BR2_PACKAGE_DRDR_INIT
	bool "drdr-init (DrDrOS PID 1)"
	help
	  drdr-init is DrDrOS's custom PID 1. It mounts /proc, /sys, /dev,
	  paints the framebuffer splash, then exec()s the shell. Replaces
	  BusyBox init when BR2_INIT_NONE=y.

	  Cross-compiled from the workspace at $(BR2_EXTERNAL_DRDROS_PATH)/../..
	  using the host's rustup toolchain (target x86_64-unknown-linux-musl).
	  Buildroot's musl is not used — the rustup target ships its own.

	  https://github.com/gravijet/DrDrOS
```
